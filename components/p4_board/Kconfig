## components/p4_board/Kconfig
```kconfig
menu "P4Key board"

config P4KEY_BOARD_PROFILE
    string "Board profile"
    default "waveshare_esp32_p4_module_dev_kit"

config P4KEY_USB_CONNECTOR
    string "Native USB device connector label"
    default "USB Type-C"

config P4KEY_BUTTON_GPIO
    int "User presence button GPIO"
    range -1 54
    default 35
    help
        GPIO35 is the BOOT Key2 input proven by the Waveshare schematic.
        Use -1 only when adapting to hardware without a proven button pin.

config P4KEY_BUTTON_ACTIVE_LOW
    bool "Button is active low"
    default y
    help
        Key2 closes GPIO35 to ground. The runtime enables an internal pull up.

endmenu
```

## components/p4_cred/Kconfig
```kconfig
menu "P4Key credential proof"

config P4KEY_CRED_REBOOT_TEST
    bool "Run wrapped credential reboot proof"
    default n
    help
        Create wrap and open one test credential then perform one software
        reboot and open the same opaque credential ID again. No credential
        or private material is logged. Restore normal firmware after the
        result is captured and keep this disabled in normal firmware.

endmenu
```

## components/p4_crypto/Kconfig
```kconfig
menu "P4Key crypto proof"

config P4KEY_CRYPTO_SELFTEST
    bool "Run crypto self tests once at boot"
    default n
    help
        Run bounded accelerator known answer negative and random smoke tests.
        Test names status and timing are logged but crypto values are not.

config P4KEY_CRYPTO_BENCH
    bool "Run crypto benchmarks after self tests"
    depends on P4KEY_CRYPTO_SELFTEST
    default n
    help
        Report minimum operation timing and repetition counts.
        Timing is supporting data and never proves hardware selection.

endmenu
```

## components/p4_ctaphid/Kconfig
```kconfig
menu "P4Key CTAPHID"

config P4KEY_HID_WAIT_TEST
    bool "Enable the synthetic CTAPHID cancel wait"
    depends on !P4KEY_USB_BRINGUP
    default n
    help
        Accept one exact nonproduction CBOR payload, emit PROCESSING
        keepalives, and finish early when CTAPHID_CANCEL arrives. Keep this
        disabled in normal firmware.

endmenu
```

## components/p4_usb/Kconfig
```kconfig
menu "P4Key USB"

config P4KEY_USB_VID
    hex "Development USB vendor ID"
    range 0x0001 0xfffe
    default 0x303a
    help
        Espressif's development VID is explicitly allowed by esp_tinyusb.
        This value is not a product shipment identity.

config P4KEY_USB_PID
    hex "Development USB product ID"
    range 0x0001 0xfffe
    default 0x4004
    help
        0x4004 is esp_tinyusb's HID-only development product mapping.
        Replace VID and PID with assigned product values before shipment.

config P4KEY_USB_BRINGUP
    bool "Enable the fixed USB bringup exchange"
    default n
    help
        Start a diagnostic task that accepts one exact nonsecret report and
        returns one exact nonsecret response. Never enable this in a normal
        FIDO firmware build.

endmenu
```
